## prj.conf
```kconfig
CONFIG_LV_Z_MEM_POOL_SIZE=16384
CONFIG_LV_Z_SHELL=y
CONFIG_MAIN_STACK_SIZE=2048

CONFIG_DISPLAY=y
CONFIG_DISPLAY_LOG_LEVEL_ERR=y

CONFIG_LOG=y
CONFIG_SHELL=y

CONFIG_LVGL=y
CONFIG_LV_MEM_CUSTOM=y
CONFIG_LV_USE_QRCODE=y
CONFIG_LV_USE_LOG=y
CONFIG_LV_USE_LABEL=y
CONFIG_LV_USE_BTN=y
CONFIG_LV_USE_ARC=y
CONFIG_LV_USE_IMG=y
CONFIG_LV_USE_MONKEY=y
CONFIG_LV_FONT_MONTSERRAT_14=y
```

## src/main.c
```c
/*
 * Copyright (c) 2018 Jan Van Winkel <jan.van_winkel@dxplore.eu>
 *
 * SPDX-License-Identifier: Apache-2.0
 */

#include <zephyr/device.h>
#include <zephyr/devicetree.h>
#include <zephyr/drivers/display.h>
#include <zephyr/drivers/gpio.h>
#include <lvgl.h>
#include <stdio.h>
#include <string.h>
#include <zephyr/kernel.h>
#include <lvgl_input_device.h>

#define LOG_LEVEL CONFIG_LOG_DEFAULT_LEVEL
#include <zephyr/logging/log.h>
LOG_MODULE_REGISTER(app);

int main(void)
{
	const struct device *display_dev;

	display_dev = DEVICE_DT_GET(DT_CHOSEN(zephyr_display));
	if (!device_is_ready(display_dev)) {
		LOG_ERR("Device not ready, aborting test");
		return 0;
	}

	lv_obj_t *qr_code = lv_qrcode_create(lv_scr_act(), 100, lv_color_hex(0x000000), lv_color_hex(0xffffff));
	lv_qrcode_update(qr_code, "https://www.nordicsemi.com/", strlen("https://www.nordicsemi.com/"));
	lv_task_handler();

	while (1) {
		lv_task_handler();
		k_sleep(K_MSEC(10000));
		lv_qrcode_update(qr_code, "https://novelbits.io/", strlen("https://novelbits.io/"));
		LOG_INF("Set QR code to https://novelbits.io/");

		lv_task_handler();
		k_sleep(K_MSEC(10000));
		lv_qrcode_update(qr_code, "https://www.nordicsemi.com/", strlen("https://www.nordicsemi.com/"));
		LOG_INF("Set QR code to https://www.nordicsemi.com/");
	}
}
```
